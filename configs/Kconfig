## configs/frontend/Kconfig
```kconfig
menu "Frontend"

    menu "common parameters"

        config FE_ADDR_WIDTH
            int "Address width (bits)"
            default 32
            help
              Front-end PC / address width (fe_pkg ADDR_WIDTH).  RV32 freezes
              this at 32.

        config FE_DATA_WIDTH
            int "Data width (bits)"
            default 32
            help
              Front-end datapath width (fe_pkg DATA_WIDTH).

        config FE_INST_WIDTH
            int "Instruction width (bits)"
            default 32
            help
              Instruction encoding width (fe_pkg INST_WIDTH).  RV32IM without
              the C extension keeps this at 32.

        config FE_FETCH_WIDTH
            int "Fetch width (instructions per Fetch Block)"
            range 1 8
            default 4
            help
              Instructions fetched per block / FTQ entry (frontend.md
              section 1).  The uBTB tag width is derived from this value.

        config FE_DECODE_WIDTH
            int "Decode width (instructions per cycle)"
            range 1 4
            default 2
            help
              IQ read-port width and the width of the FE/BE instruction
              interface (frontend_backend_contract.md section 2).

    endmenu # "common parameters"

    menu "BPU"

        menu "Direction predictors"

            config FE_BIMODAL
                bool "Bimodal direction predictor"
                default n
                help
                  One-cycle bimodal predictor.  Exactly one of FE_BIMODAL /
                  FE_TOURNAMENT must be enabled; bpu.sv checks this at time 0.

            config FE_TOURNAMENT
                bool "Tournament direction predictor (gshare + bimodal chooser)"
                default y
                help
                  One-cycle gshare + bimodal tournament.  When FE_TAGE is
                  enabled the full TAGE still owns the S2 precise direction and
                  the tournament only supplies the S1 base direction.

            config FE_PHT_WIDTH
                int "PHT index width (bits)"
                range 4 16
                default 8
                help
                  log2 of the gshare / bimodal / chooser entry count.

            config FE_GHR_WIDTH
                int "Global history register width (bits)"
                range 2 24
                default 12
                help
                  Width of the speculative global history register.

        endmenu # "Direction predictors"

        menu "TAGE (S2 precise direction)"

            config FE_TAGE
                bool "Enable TAGE"
                default y
                help
                  Tagged geometric-history predictor for the S2 precise
                  direction and correction stage.

            config FE_TAGE_NUM_TABLES
                int "Tagged tables (T1..Tn)"
                range 1 8
                default 8

            config FE_TAGE_GHV_WIDTH
                int "Global branch history width (bits)"
                range 160 512
                default 160
                help
                  Must cover the longest enabled history length (144 with the
                  default 8 tables).

            config FE_TAGE_INDEX_WIDTH
                int "Tagged table index width (bits)"
                range 8 14
                default 8

            config FE_TAGE_TAG_WIDTH
                int "Partial tag width (bits)"
                range 4 14
                default 10

            config FE_TAGE_CTR_WIDTH
                int "Signed counter width (bits)"
                range 2 8
                default 4

            config FE_TAGE_USEFUL_WIDTH
                int "Useful counter width (bits)"
                range 1 4
                default 1

            config FE_TAGE_CKPT_DEPTH
                int "History checkpoint depth (entries)"
                range 8 512
                default 64

            config FE_TAGE_USE_ALT_ON_NA
                bool "Use the alternate prediction for weak providers"
                default y

            config FE_UTAGE
                bool "Enable uTAGE as the S1 fast direction predictor"
                default n
                help
                  Small MicroTage-style predictor (few tagged tables with short
                  folded histories) for the S1 direction.  The full TAGE still
                  owns S2.  With the current single speculative history this
                  trades accuracy for a shorter S1 select path, so it defaults
                  off; see docs/tage-design notes in the ported RTL.

        endmenu # "TAGE (S2 precise direction)"

        menu "Target predictors (uBTB / mBTB / RAS)"

            config FE_UBTB
                bool "Enable uBTB target predictor"
                default y

            config FE_UBTB_WIDTH
                int "uBTB entry-count width (log2 entries)"
                range 4 8
                default 7
                help
                  log2 of the uBTB entry count (7 -> 128 entries).  The RTL
                  splits them into 16 banks x (entries/16) ways.

            config FE_MBTB
                bool "Enable mBTB target predictor"
                default y
                help
                  Region BTB used as the S2 target refiner and the second CFI
                  provider for the S2 TAGE merge.

            config FE_MBTB_WIDTH
                int "mBTB set index width (log2 sets)"
                range 4 16
                default 7
                help
                  log2 of the mBTB set count; 4 ways per set (7 -> 128 sets,
                  512 entries).

            config FE_RAS
                bool "Return-address stack"
                default y
                help
                  Enable the call/return stack.  When disabled, returns fall
                  back to the uBTB/mBTB target.

            config FE_RAS_ENTRIES
                int "Return-address stack depth (entries)"
                range 2 256
                default 64
                help
                  Number of return addresses held by the RAS.

        endmenu # "Target predictors (uBTB / mBTB / RAS)"

        menu "Loop predictor"

            config FE_LOOP_PRED
                bool "Loop predictor"
                default y
                help
                  Independent loop-iteration direction predictor that overrides
                  the selected direction predictor near the loop trip count.

            config FE_LOOP_ENTRIES
                int "Loop predictor table entries"
                range 16 4096
                default 32

            config FE_LOOP_ITER_WIDTH
                int "Loop iteration counter width (bits)"
                range 2 16
                default 16

        endmenu # "Loop predictor"

    endmenu # "BPU"

    menu "FTQ"

        config FE_FTQ_NUM_ENTRIES
            int "Fetch Target Queue entries"
            range 2 64
            default 24
            help
              Number of pending Fetch Blocks tracked by the FTQ
              (frontend.md section 5).

    endmenu # "FTQ"

    menu "ICache"

        config FE_ICACHE_LINE_BYTES
            int "Cache line size (bytes)"
            range 16 128
            default 32
            help
              ICache line size; drives the refill beat count.  ARES uses 32.

        config FE_ICACHE_LINE_32
            bool "32-byte line geometry marker"
            default y
            help
              Legacy port marker paired with FE_ICACHE_LINE_BYTES=32.  It is
              kept so the generated macro set matches the original front-end
              autoconf.vh; changing it alone does not change the RTL.

        config FE_ICACHE_NR_SETS
            int "Number of sets"
            range 1 1024
            default 64
            help
              ICache set count (frontend.md section 7.1).  ARES uses 64.

        config FE_ICACHE_SETS_64
            bool "64-set geometry marker"
            default y
            help
              Legacy port marker paired with FE_ICACHE_NR_SETS=64.

        config FE_ICACHE_NR_WAYS
            int "Associativity (ways)"
            range 1 16
            default 4
            help
              ICache associativity (frontend.md section 7.1).  ARES uses 4-way.

        config FE_ICACHE_WAYS_4
            bool "4-way geometry marker"
            default y
            help
              Legacy port marker paired with FE_ICACHE_NR_WAYS=4.

        config IO_USE_AXI
            bool "AXI4-Lite ICache backing bus"
            default y
            help
              Selects the ICache master bus.  When set, the front-end exposes
              the AXI4-Lite interface (rtl/frontend/interface/axi_if.sv); when
              cleared it uses the miniTensor uncached read handshake.  This is
              the `IO_USE_AXI macro in rtl/frontend/include/autoconf.vh; the
              generated header spells it CONFIG_IO_USE_AXI.

    endmenu # "ICache"

    menu "IQ"

        config FE_BODY_DEPTH
            int "Instruction Queue body depth (entries)"
            range 1 256
            default 8
            help
              Body (circular queue) depth of the IQ; the total depth is
              IQ_DEPTH = FE_BODY_DEPTH + FE_DECODE_WIDTH (the decode window is
              the HEAD).  The ported ARES RTL uses a body of 8.

    endmenu # "IQ"

endmenu # "Frontend"
```

## npc/configs/Kconfig
```kconfig
mainmenu "Mundus Simulation Configuration Menu"

menu "Simulation Settings"

config SIMULATION
  bool "Enable RTL Simulation"
  default "y"

# TODO: This seems to have a problem
config HAS_VERILATOR
  depends on SIMULATION
  bool "Enable Verilator functions"
  default "y"

config SOC_DELAY
  depends on SIMULATION
  bool "Enable SoC delayer"
  default "y"

config DEBUG
  depends on SIMULATION
  bool "Enable debug information"
  default "n"

config FORCE_WAVE
  depends on SIMULATION
  bool "Force open waveform"
  default "n"

config CORE_FREQ
  string "Core clock frequency (MHz)"
  default "300.000"

endmenu # "Simulation Settings"

source "configs/Mundus/Kconfig"

source "configs/NPC/Kconfig"

source "configs/SoC/Kconfig"

source "configs/Testing&Debugging/Kconfig"
```
